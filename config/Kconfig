## config/dts/bindings/behaviors/zmk,behavior-display-toggle.yaml
```yaml
description: Toggle the display on/off (blanking)

compatible: "zmk,behavior-display-toggle"

include: zero_param.yaml
```

## config/dts/bindings/behaviors/zmk,behavior-en-caps.yaml
```yaml
description: Caps Word for English words that reports its state

compatible: "zmk,behavior-en-caps"

include: zero_param.yaml
```

## config/dts/bindings/behaviors/zmk,behavior-led-battery.yaml
```yaml
description: LED battery behavior

compatible: "zmk,behavior-led-battery"

include: zero_param.yaml
```

## config/dts/bindings/behaviors/zmk,behavior-led-flash.yaml
```yaml
description: Short dim flash of the LED strip (0 = red, 1 = green)

compatible: "zmk,behavior-led-flash"

include: one_param.yaml
```

## config/dts/bindings/behaviors/zmk,behavior-led-rgb.yaml
```yaml
description: RGB controls with hold-to-repeat and immediate redraw

compatible: "zmk,behavior-led-rgb"

include: one_param.yaml
```

## config/dts/bindings/behaviors/zmk,behavior-led-sync.yaml
```yaml
description: LED sync behavior

compatible: "zmk,behavior-led-sync"

include: one_param.yaml
```

## config/dts/bindings/behaviors/zmk,behavior-ru-caps.yaml
```yaml
description: Caps Word for Russian words (shifts and keeps going on the keys of х ъ ж э б ю ё)

compatible: "zmk,behavior-ru-caps"

include: zero_param.yaml
```

## config/dts/bindings/behaviors/zmk,behavior-snippet.yaml
```yaml
description: Letter key that types a text snippet while the Ctrl+Shift+Backspace chord is held

compatible: "zmk,behavior-snippet"

include: two_param.yaml
```

## config/dts/bindings/behaviors/zmk,behavior-tap-signal.yaml
```yaml
description: Signal "a key was pressed on the other half" (for the peripheral Bongo Cat)

compatible: "zmk,behavior-tap-signal"

include: zero_param.yaml
```

## config/dts/bindings/behaviors/zmk,behavior-ug-caps.yaml
```yaml
description: Per-layer RGB color that turns red while Caps is active

compatible: "zmk,behavior-ug-caps"

include: one_param.yaml
```

## config/dts/bindings/behaviors/zmk,behavior-ug-solid.yaml
```yaml
description: Per-layer RGB color taken from the current solid color (hue/saturation), scaled by brightness

compatible: "zmk,behavior-ug-solid"

include: zero_param.yaml
```
